## vim/spell/dicts/kconfig.dict
```kconfig
bool
boolean
choice
comment
config
default
def_bool
def_tristate
endchoice
endif
endmenu
FIXME
hex
if
int
m
mainmenu
menu
menuconfig
n
NOTE
optional
prompt
range
requires
select
source
string
TODO
tristate
XXX
y
```
